## Documentation/devicetree/bindings/interrupt-controller/qcom,h2-pic.txt
```
Qualcomm Technologies, Inc. Hexagon Hypervisor Virtual Interrupt Controller

This is the virtual interrupt controller presented to the guest by the
hypervisor.

Required Properties:
- compatible: must be "qcom,h2-pic"
- interrupt-controller: node is an interrupt controller
- #interrupt-cells: number of cells needed to describe interrupt source


Example:

	interrupt-controller {
		compatible = "qcom,h2-pic";
		interrupt-controller;
		#interrupt-cells = <1>;
	};
```

## Documentation/devicetree/bindings/timer/qcom,h2-timer.txt
```
Qualcomm Technologies, Inc. Hexagon Hypervisor Virtual Timer

This is the virtual timer interface presented to the guest by the
hypervisor.

Required Properties:
- compatible: must be "qcom,h2-timer"
- interrupts: interrupt number for the timer; usually 12


Example:

	timer {
		compatible="qcom,h2-timer";
		interrupts = <12>;
	};
```

## arch/hexagon/Kconfig
```kconfig
# Hexagon configuration
comment "Linux Kernel Configuration for Hexagon"

config HEXAGON
	def_bool y
	select HAVE_OPROFILE
	# Other pending projects/to-do items.
	# select HAVE_REGS_AND_STACK_ACCESS_API
	# select HAVE_HW_BREAKPOINT if PERF_EVENTS
	# select ARCH_HAS_CPU_IDLE_WAIT
	# select ARCH_WANT_OPTIONAL_GPIOLIB
	# select ARCH_REQUIRE_GPIOLIB
	# select HAVE_CLK
	# select GENERIC_PENDING_IRQ if SMP
	select GENERIC_ATOMIC64
	select HAVE_PERF_EVENTS
	# GENERIC_ALLOCATOR is used by dma_alloc_coherent()
	select GENERIC_ALLOCATOR
	select GENERIC_IRQ_SHOW
	select HAVE_ARCH_KGDB
	select HAVE_ARCH_TRACEHOOK
	select NO_IOPORT_MAP
	select GENERIC_IOMAP
	select GENERIC_SMP_IDLE_THREAD
	select STACKTRACE_SUPPORT
	select GENERIC_CLOCKEVENTS
	select GENERIC_CLOCKEVENTS_BROADCAST
	select MODULES_USE_ELF_RELA
	select GENERIC_CPU_DEVICES
	select HAVE_DMA_ATTRS
	select IRQ_DOMAIN
	---help---
	  Qualcomm Hexagon is a processor architecture designed for high
	  performance and low power across a wide variety of applications.

config HEXAGON_PHYS_OFFSET
	def_bool y
	---help---
	  Platforms that don't load the kernel at zero set this.

config FRAME_POINTER
	def_bool y

config LOCKDEP_SUPPORT
	def_bool y

config PCI
	def_bool n

config EARLY_PRINTK
	def_bool y

config MMU
	def_bool y

config TRACE_IRQFLAGS_SUPPORT
	def_bool y

config GENERIC_CSUM
	def_bool y

config GENERIC_CALIBRATE_DELAY
	def_bool y

config HEXAGON_SPLIT_2GB
	def_bool n
	---help---
	  Kernel/user split is at 2GB instead of 3GB (0xc0000000)

#
# Use the generic interrupt handling code in kernel/irq/:
#
config GENERIC_IRQ_PROBE
	def_bool y

config NEED_SG_DMA_LENGTH
	def_bool y

config RWSEM_GENERIC_SPINLOCK
	def_bool n

config RWSEM_XCHGADD_ALGORITHM
	def_bool y

config GENERIC_HWEIGHT
	def_bool y

config STACKTRACE_SUPPORT
	def_bool y
	select STACKTRACE

config GENERIC_BUG
	def_bool y
	depends on BUG

menu "Machine selection"

choice
	prompt "System type"
	default HEXAGON_MSM8974

config HEXAGON_MSM8974
	bool "MSM8974"
	select HEXAGON_PHYS_OFFSET
	select HAVE_DMA_ATTRS
	select ARCH_REQUIRE_GPIOLIB
	select GENERIC_GPIO
	select HEXAGON_SPLIT_2GB
	select COMMON_CLK
	select HEXAGON_H2_PIC
	---help---
	  Enable support for MSM8974 devices.

config HEXAGON_MSM8996
	bool "MSM8996"
	select HEXAGON_PHYS_OFFSET
	select HEXAGON_H2_PIC
	select HAVE_DMA_ATTRS
	---help---
	  Support for MSM8996

config HEXAGON_COMET
	bool "Comet Board"
	---help---
	  Support for the Comet platform.

endchoice

config HEXAGON_LLVM
	bool "LLVM"
	default n
	---help---
	  Switch to adjust compilation flags for LLVM

config HEXAGON_ARCH_VERSION
	int "Architecture version (1 - 65)"
	range 1 65
	default 60

config HEXAGON_FORCE_USR
	bool "Force USR bit at start of process"
	default y
	help
	  If set, new processes will have their USR bit forced to a specified
	  value.

config HEXAGON_USR_VAL
	hex "USR value to force"
	default 0x56000
	depends on HEXAGON_FORCE_USR

config USE_OF
	default n
	bool "Device Tree support"
	select OF
	select OF_EARLY_FLATTREE

config DTB_BUILTIN
	def_bool y
	help
	  Temporary bringup option; assumes DTB is built into kernel somewhere.

config CMDLINE
	string "Default kernel command string"
	default ""
	help
	  On some platforms, there is currently no way for the boot loader
	  to pass arguments to the kernel. For these, you should supply some
	  command-line options at build time by entering them here.  At a
	  minimum, you should specify the memory size and the root device
	  (e.g., mem=64M root=/dev/nfs).

config SMP
	bool "Multi-Processing support"
	---help---
	  Enables SMP support in the kernel.  If unsure, say "Y"

config NR_CPUS
	int "Maximum number of CPUs" if SMP
	range 2 6 if SMP
	default "1" if !SMP
	default "6" if SMP
	---help---
	  This allows you to specify the maximum number of CPUs which this
	  kernel will support.  The maximum supported value is 6 and the
	  minimum value which makes sense is 2.

	  This is purely to save memory - each supported CPU adds
	  approximately eight kilobytes to the kernel image.

config BASE_IPI_IRQ
	int "Base IPI IRQ" if SMP
	default 8
	---help---
	  The base IRQ used for IPI calls.  Each CPU increments by one,
	  although the newer hypervisor API specifies the lower range of
	  interrupts to be percpu anyways.

choice
	prompt "Kernel page size"
	default PAGE_SIZE_4KB
	---help---
	  Changes the default page size; use with caution.

config PAGE_SIZE_4KB
	bool "4KB"

config PAGE_SIZE_16KB
	bool "16KB"

config PAGE_SIZE_64KB
	bool "64KB"

config PAGE_SIZE_256KB
	bool "256KB"

endchoice

source "mm/Kconfig"

source "kernel/Kconfig.hz"

endmenu

source "init/Kconfig"
source "kernel/Kconfig.freezer"
source "drivers/Kconfig"
source "fs/Kconfig"

menu "Executable File Formats"
source "fs/Kconfig.binfmt"
endmenu

source "net/Kconfig"
source "security/Kconfig"
source "crypto/Kconfig"
source "lib/Kconfig"

menu "Kernel hacking"
source "lib/Kconfig.debug"
endmenu
```

## arch/hexagon/configs/msm8974_defconfig
```kconfig
CONFIG_HEXAGON_ARCH_VERSION=5
CONFIG_USE_OF=y
CONFIG_SMP=y
CONFIG_NR_CPUS=3
CONFIG_PAGE_SIZE_64KB=y
# CONFIG_COMPACTION is not set
CONFIG_HZ_100=y
CONFIG_CROSS_COMPILE="hexagon-linux-"
# CONFIG_LOCALVERSION_AUTO is not set
# CONFIG_CROSS_MEMORY_ATTACH is not set
# CONFIG_USELIB is not set
# CONFIG_COMPAT_BRK is not set
# CONFIG_UEVENT_HELPER is not set
# CONFIG_STANDALONE is not set
# CONFIG_PREVENT_FIRMWARE_BUILD is not set
# CONFIG_DEVMEM is not set
# CONFIG_DEVKMEM is not set
# CONFIG_HW_RANDOM is not set
# CONFIG_HWMON is not set
# CONFIG_USB_SUPPORT is not set
# CONFIG_IOMMU_SUPPORT is not set
# CONFIG_DNOTIFY is not set
# CONFIG_INOTIFY_USER is not set
# CONFIG_MISC_FILESYSTEMS is not set
# CONFIG_BINFMT_ELF is not set
# CONFIG_BINFMT_SCRIPT is not set
# CONFIG_ENABLE_WARN_DEPRECATED is not set
# CONFIG_ENABLE_MUST_CHECK is not set
```

## arch/hexagon/configs/msm8996_defconfig
```kconfig
CONFIG_HEXAGON_MSM8996=y
CONFIG_HEXAGON_LLVM=y
CONFIG_USE_OF=y
CONFIG_CMDLINE="maxcpus=4 debug mem=40M console=hvc0"
CONFIG_SMP=y
CONFIG_NR_CPUS=4
# CONFIG_COMPACTION is not set
CONFIG_DEFAULT_MMAP_MIN_ADDR=0
CONFIG_HZ_100=y
CONFIG_CROSS_COMPILE="hexagon-"
CONFIG_LOCALVERSION="-smp"
# CONFIG_LOCALVERSION_AUTO is not set
# CONFIG_SWAP is not set
# CONFIG_CROSS_MEMORY_ATTACH is not set
# CONFIG_USELIB is not set
CONFIG_IKCONFIG=y
CONFIG_IKCONFIG_PROC=y
CONFIG_LOG_BUF_SHIFT=18
CONFIG_BLK_DEV_INITRD=y
CONFIG_INITRAMFS_SOURCE="initramfs.cpio.gz"
# CONFIG_RD_BZIP2 is not set
# CONFIG_RD_LZMA is not set
# CONFIG_RD_XZ is not set
# CONFIG_RD_LZO is not set
# CONFIG_RD_LZ4 is not set
# CONFIG_KALLSYMS is not set
CONFIG_EMBEDDED=y
# CONFIG_VM_EVENT_COUNTERS is not set
CONFIG_SLOB=y
# CONFIG_LBDAF is not set
# CONFIG_BLK_DEV_BSG is not set
CONFIG_UEVENT_HELPER_PATH="/sbin/hotplug"
# CONFIG_STANDALONE is not set
CONFIG_BLK_DEV_LOOP=y
# CONFIG_INPUT_MOUSEDEV is not set
# CONFIG_INPUT_KEYBOARD is not set
# CONFIG_INPUT_MOUSE is not set
# CONFIG_SERIO is not set
# CONFIG_CONSOLE_TRANSLATIONS is not set
CONFIG_LEGACY_PTY_COUNT=64
# CONFIG_DEVKMEM is not set
# CONFIG_HW_RANDOM is not set
# CONFIG_HWMON is not set
# CONFIG_VGA_CONSOLE is not set
# CONFIG_USB_SUPPORT is not set
# CONFIG_IOMMU_SUPPORT is not set
# CONFIG_FILE_LOCKING is not set
# CONFIG_DNOTIFY is not set
# CONFIG_INOTIFY_USER is not set
CONFIG_PROC_KCORE=y
CONFIG_TMPFS=y
CONFIG_TMPFS_POSIX_ACL=y
# CONFIG_MISC_FILESYSTEMS is not set
# CONFIG_COREDUMP is not set
CONFIG_CRYPTO_MD5=y
CONFIG_CRYPTO_AES=y
# CONFIG_CRYPTO_HW is not set
CONFIG_CRC_CCITT=y
CONFIG_CRC16=y
CONFIG_CRC_T10DIF=y
CONFIG_LIBCRC32C=y
# CONFIG_ENABLE_WARN_DEPRECATED is not set
# CONFIG_ENABLE_MUST_CHECK is not set
CONFIG_FRAME_WARN=0
CONFIG_DEBUG_FS=y
CONFIG_MAGIC_SYSRQ=y
# CONFIG_SCHED_DEBUG is not set
# CONFIG_DEBUG_BUGVERBOSE is not set
# CONFIG_FTRACE is not set
```
